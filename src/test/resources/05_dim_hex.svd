# 05_dim_hex register map
CPU: 
Address unit: 32 bits
Registers are 32-bit, read-write, reset 0x0 unless marked. A register's access mark holds for its fields unless they carry their own. Offsets are from the block's base; lines under a group give offsets from that group; [hi:lo] are bit positions; {n}, {i} and the like mark numbered series; 'fields as' and 'values as' point back to an identical list; <NAME> marks a mode.

## Memory map
0x00000000 DIMPERIPH size 0x100

## DIMPERIPH
Base 0x00000000
{0x50+4i} DIMREG[{i}] (i=0..3)
