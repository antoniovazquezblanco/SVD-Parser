# EnumeratedValuesTest register map
File version: 1.0
Test device for enumeratedValues and enumeratedValue tags in fields
Registers are 32-bit, access not given, no defined reset value unless marked. A register's access mark holds for its fields unless they carry their own. Offsets are from the block's base; lines under a group give offsets from that group; [hi:lo] are bit positions; {n}, {i} and the like mark numbered series; 'fields as' and 'values as' point back to an identical list; <NAME> marks a mode.

## Memory map
0x40000000 PERIPH0 size 0x100 — Test peripheral

## PERIPH0 — Test peripheral
Base 0x40000000
0x00 STATUS — Status register with an enumerated field
  [1:0] MODE — Operating mode
    0=IDLE (Device is idle); 1=RUN (Device is running); 2=SLEEP (Device is in sleep mode); 3=ERROR (Device is in error state)
