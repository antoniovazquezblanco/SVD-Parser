# AlternateRegisterTest register map
File version: 1.0
Test device for the alternateRegister tag identifying overlapping registers
Registers are 32-bit, access not given, no defined reset value unless marked. A register's access mark holds for its fields unless they carry their own. Offsets are from the block's base; lines under a group give offsets from that group; [hi:lo] are bit positions; {n}, {i} and the like mark numbered series; 'fields as' and 'values as' point back to an identical list; <NAME> marks a mode.

## Memory map
0x40024000 FLASH size 0x100 — Flash controller peripheral

## FLASH — Flash controller peripheral
Base 0x40024000
0x08 ERASEPAGE — Register for erasing a page in code region 0
0x08 ERASEPCR0 (alternate view of ERASEPAGE) — Alias for ERASEPAGE (alternate register at same offset)
