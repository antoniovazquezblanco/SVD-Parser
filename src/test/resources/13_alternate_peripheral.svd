# AlternatePeripheralTest register map
File version: 1.0
Test device for the alternatePeripheral tag identifying overlapping peripherals
Registers are 32-bit, access not given, no defined reset value unless marked. A register's access mark holds for its fields unless they carry their own. Offsets are from the block's base; lines under a group give offsets from that group; [hi:lo] are bit positions; {n}, {i} and the like mark numbered series; 'fields as' and 'values as' point back to an identical list; <NAME> marks a mode.

## Memory map
0x40010000 TIMER0 size 0x100 — Timer 0 peripheral
0x40010000 COUNTER0 size 0x100 — Counter 0, mapped at the same address as TIMER0

## TIMER0 — Timer 0 peripheral
Base 0x40010000
0x00 CR — Control register

## COUNTER0 — Counter 0, mapped at the same address as TIMER0
Base 0x40010000; alternate view of TIMER0
0x04 CNT — Counter register
