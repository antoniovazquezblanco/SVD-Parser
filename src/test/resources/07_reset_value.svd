# ResetValueTest register map
File version: 1.0
Test device for resetValue and resetMask tags at device and register levels
Registers are 32-bit, access not given, reset 0xDEADBEEF unless marked. A register's access mark holds for its fields unless they carry their own. Offsets are from the block's base; lines under a group give offsets from that group; [hi:lo] are bit positions; {n}, {i} and the like mark numbered series; 'fields as' and 'values as' point back to an identical list; <NAME> marks a mode.

## Memory map
0x40000000 PERIPH0 size 0x100 — Test peripheral

## PERIPH0 — Test peripheral
Base 0x40000000
0x00 REG0 (reset mask 0xFFFF0000) — Register with custom reset value and mask
0x04 REG1 reset 0x0 — Register inheriting device-level reset value and mask
