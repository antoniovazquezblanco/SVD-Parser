# ClusterNestedTest register map
File version: 1.0
Test device for a cluster nested inside another cluster
Registers are 32-bit, access not given, no defined reset value unless marked. A register's access mark holds for its fields unless they carry their own. Offsets are from the block's base; lines under a group give offsets from that group; [hi:lo] are bit positions; {n}, {i} and the like mark numbered series; 'fields as' and 'values as' point back to an identical list; <NAME> marks a mode.

## Memory map
0x40000000 PERIPH0 size 0x200 — Peripheral with nested clusters

## PERIPH0 — Peripheral with nested clusters
Base 0x40000000
0x100 OUTER group — Outer cluster
  0x00 DATA — Register directly inside OUTER cluster
  0x20 INNER group — Inner cluster nested inside OUTER
    0x00 REG — Register inside the nested cluster
