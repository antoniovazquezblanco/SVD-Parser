# 02_register_no_description register map
CPU: 
Address unit: 32 bits
Registers are 32-bit, write-only, reset 0x0 unless marked. A register's access mark holds for its fields unless they carry their own. Offsets are from the block's base; lines under a group give offsets from that group; [hi:lo] are bit positions; {n}, {i} and the like mark numbered series; 'fields as' and 'values as' point back to an identical list; <NAME> marks a mode.

## Memory map
0x00000000 DUMMY size 0x1000 — Dummy peripheral

## DUMMY — Dummy peripheral
Base 0x00000000
0x00 REG
  [0] FIELD — Field description
