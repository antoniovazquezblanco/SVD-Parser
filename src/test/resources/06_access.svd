# AccessTest register map
File version: 1.0
Test device for access tag at device, register and field levels
Registers are 32-bit, read-only, no defined reset value unless marked. A register's access mark holds for its fields unless they carry their own. Offsets are from the block's base; lines under a group give offsets from that group; [hi:lo] are bit positions; {n}, {i} and the like mark numbered series; 'fields as' and 'values as' point back to an identical list; <NAME> marks a mode.

## Memory map
0x40000000 PERIPH0 size 0x100 — Test peripheral

## PERIPH0 — Test peripheral
Base 0x40000000
0x00 REG_RO — Read-only register
  [7:0] FIELD0 — A read-only field
0x04 REG_WO wo — Write-only register
  [7:0] FIELD0 — A write-only field
0x08 REG_RW rw — Read-write register (inherited from device)
