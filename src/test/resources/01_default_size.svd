# DeviceName register map
Vendor: SomeVendor; Series: DeviceSeries; File version: 1
DeviceName description
CPU: CM3 r1p0, little endian, MPU, FPU, 3 interrupt priority bits
Registers are 16-bit, read-write, reset 0x0 unless marked. A register's access mark holds for its fields unless they carry their own. Offsets are from the block's base; lines under a group give offsets from that group; [hi:lo] are bit positions; {n}, {i} and the like mark numbered series; 'fields as' and 'values as' point back to an identical list; <NAME> marks a mode.

## Memory map
0x10000000 PERIPH1 size 0x1000 — Peripheral with a 16-bit size override
0x20000000 PERIPH2 size 0x1000 — Peripheral without a size override, inheriting the device default

## PERIPH1 — Peripheral with a 16-bit size override
Base 0x10000000
0x00 REG_FROM_PERIPH ro reset 0xFFFF — Register inheriting size from the peripheral
  [15:0] FIELD1 — A register field
0x02 REG_OVERRIDE 8-bit — Register overriding the inherited size with an explicit 8-bit value

## PERIPH2 — Peripheral without a size override, inheriting the device default
Base 0x20000000
0x00 REG_FROM_DEVICE 32-bit — Register inheriting size from the device
