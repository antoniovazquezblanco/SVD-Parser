# ClusterTest register map
File version: 1.0
Test device for the cluster tag grouping registers inside a peripheral
Registers are 32-bit, access not given, no defined reset value unless marked. A register's access mark holds for its fields unless they carry their own. Offsets are from the block's base; lines under a group give offsets from that group; [hi:lo] are bit positions; {n}, {i} and the like mark numbered series; 'fields as' and 'values as' point back to an identical list; <NAME> marks a mode.

## Memory map
0x40000000 PERIPH0 size 0x200 — Test peripheral with a cluster

## PERIPH0 — Test peripheral with a cluster
Base 0x40000000
0x00 CTRL — Control register
0x100 CH group — Channel configuration cluster
  0x00 CONFIG — Channel configuration register
  0x04 STATUS ro — Channel status register
