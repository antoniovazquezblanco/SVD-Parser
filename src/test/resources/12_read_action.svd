# ReadActionTest register map
File version: 1.0
Test device for the readAction tag in registers
Registers are 32-bit, access not given, no defined reset value unless marked. A register's access mark holds for its fields unless they carry their own. Offsets are from the block's base; lines under a group give offsets from that group; [hi:lo] are bit positions; {n}, {i} and the like mark numbered series; 'fields as' and 'values as' point back to an identical list; <NAME> marks a mode.

## Memory map
0x40002000 UART size 0x100 — UART peripheral

## UART — UART peripheral
Base 0x40002000
0x00 DR read-clears — Data register - reading clears the data
0x04 ISR read-has-side-effects — Interrupt status - reading triggers external modification
0x08 SR read-sets — Status register - reading sets the register
