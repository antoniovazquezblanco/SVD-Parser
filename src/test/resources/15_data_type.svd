# DataTypeTest register map
File version: 1.0
Test device for the dataType tag specifying the C type of a register
Registers are 32-bit, access not given, no defined reset value unless marked. A register's access mark holds for its fields unless they carry their own. Offsets are from the block's base; lines under a group give offsets from that group; [hi:lo] are bit positions; {n}, {i} and the like mark numbered series; 'fields as' and 'values as' point back to an identical list; <NAME> marks a mode.

## Memory map
0x40030000 SENSOR size 0x100 — Sensor peripheral

## SENSOR — Sensor peripheral
Base 0x40030000
0x00 TEMP — Temperature reading as a signed 32-bit integer
0x04 ACCEL 16-bit — Acceleration reading as a signed 16-bit integer
