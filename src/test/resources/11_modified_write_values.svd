# ModifiedWriteValuesTest register map
File version: 1.0
Test device for the modifiedWriteValues tag in registers
Registers are 32-bit, read-write, no defined reset value unless marked. A register's access mark holds for its fields unless they carry their own. Offsets are from the block's base; lines under a group give offsets from that group; [hi:lo] are bit positions; {n}, {i} and the like mark numbered series; 'fields as' and 'values as' point back to an identical list; <NAME> marks a mode.

## Memory map
0x50000000 GPIO size 0x100 — GPIO peripheral

## GPIO — GPIO peripheral
Base 0x50000000
0x00 OUTSET write-1-sets — Set individual output bits - writing 1 sets the bit
0x04 OUTCLR write-1-clears — Clear individual output bits - writing 1 clears the bit
0x08 OUTTGL write-1-toggles — Toggle individual output bits - writing 1 toggles the bit
