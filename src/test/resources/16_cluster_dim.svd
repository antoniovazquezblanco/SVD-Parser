# ClusterDimTest register map
File version: 1.0
Test device for an array of clusters using dim/dimIncrement
Registers are 32-bit, read-write, no defined reset value unless marked. A register's access mark holds for its fields unless they carry their own. Offsets are from the block's base; lines under a group give offsets from that group; [hi:lo] are bit positions; {n}, {i} and the like mark numbered series; 'fields as' and 'values as' point back to an identical list; <NAME> marks a mode.

## Memory map
0x40000000 PERIPH0 size 0x100 — Peripheral with a two-element cluster array

## PERIPH0 — Peripheral with a two-element cluster array
Base 0x40000000
{0x10+0x20*i} CH{i} (i=0..1) group — Channel cluster
  0x00 CTRL — Channel control register (inherits read-write from cluster)
  0x04 STATUS ro — Channel status register (overrides to read-only)
