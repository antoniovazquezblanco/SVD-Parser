# InterruptTest register map
File version: 1.0
Test device for the interrupt tag in peripherals
Registers are 32-bit, access not given, no defined reset value unless marked. A register's access mark holds for its fields unless they carry their own. Offsets are from the block's base; lines under a group give offsets from that group; [hi:lo] are bit positions; {n}, {i} and the like mark numbered series; 'fields as' and 'values as' point back to an identical list; <NAME> marks a mode.

## Memory map
0x40002000 UART0 size 0x100 — UART 0 peripheral with multiple interrupts
0x40010000 TIMER0 size 0x100 — Timer 0 peripheral

## Interrupts
16 TIMER0 — Timer 0 interrupt
28 UART0_RX (UART0) — UART 0 receive interrupt
29 UART0_TX (UART0) — UART 0 transmit interrupt

## TIMER0 — Timer 0 peripheral
Base 0x40010000
0x00 CR — Control register

## UART0 — UART 0 peripheral with multiple interrupts
Base 0x40002000
0x00 DR — Data register
